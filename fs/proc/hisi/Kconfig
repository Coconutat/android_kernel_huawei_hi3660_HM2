## fs/proc/hisi/Kconfig
```kconfig
if PROC_FS=y

menuconfig HISI_PROC
	bool "hisilicon proc support"
	depends on PROC_FS
	help
	  select hisilicon proc.

config HISI_PROC_HARDWARE
	bool "/proc/hardware support"
	depends on HISI_PROC && OF
	help
	  read the /proc/hardware to get hardware info.

endif # PROC_FS
```
